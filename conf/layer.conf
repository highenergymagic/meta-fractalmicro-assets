## conf/layer.conf
```bitbake
# SPDX-License-Identifier: MIT
BBPATH .= ":${LAYERDIR}"
BBFILES += "${LAYERDIR}/recipes-*/*/*.bb ${LAYERDIR}/recipes-*/*/*.bbappend"
BBFILE_COLLECTIONS += "fractalmicro_assets"
BBFILE_PATTERN_fractalmicro_assets = "^${LAYERDIR}/"
BBFILE_PRIORITY_fractalmicro_assets = "6"
LAYERDEPENDS_fractalmicro_assets = "core"
LAYERSERIES_COMPAT_fractalmicro_assets = "wrynose"
```
